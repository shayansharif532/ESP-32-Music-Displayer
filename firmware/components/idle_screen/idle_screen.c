/* The idle screen (see idle_screen.h): themes, clock, date, custom line, background picture, persistence, sync with the companion.
 *
 * Cost model (this runs next to Wi-Fi and the player): the background is one pre-baked RGB565 image in PSRAM (a dithered gradient
 * generated here for Minimal / Dark / Neon, or the companion's JPEG decoded once for Photo), so LVGL only blits it. Nothing animates
 * except the screen fade done by the caller; the only timer is a 1 s clock tick that runs while the screen is visible and only
 * touches a label when the minute changes. Buffers are allocated for a settings change and swapped in under the LVGL lock, never
 * rewritten while they are on screen.
 */
#include "idle_screen.h"

#include <math.h>
#include <stdio.h>
#include <stdlib.h>
#include <string.h>

#include "bsp/esp-bsp.h"
#include "cJSON.h"
#include "esp_heap_caps.h"
#include "esp_log.h"
#include "esp_partition.h"
#include "esp_rom_crc.h"
#include "esp_timer.h"
#include "freertos/FreeRTOS.h"
#include "freertos/semphr.h"
#include "freertos/task.h"
#include "idle_date.h"
#include "jpeg_decoder.h"
#include "nvs.h"

static const char *TAG = "idle";

extern const lv_font_t idle_font_clock;               /* font_clock.c (generated by tools/gen_clock_font.py) */

#define SCR                 480
#define BG_BYTES            (SCR * SCR * 2)
#define RGB_BYTES           (SCR * SCR * 3)

#define NVS_NS              "idle"
#define NVS_KEY             "cfg"
#define CFG_MAGIC           0x49444C32U               /* "IDL2": IDL1 + the date options (an IDL1 blob is migrated, see nvs_load_cfg) */
#define CFG_MAGIC_V1        0x49444C31U
#define PART_LABEL          "idle_img"
#define PART_SUBTYPE        0x40
#define IMG_MAGIC           0x31494449U               /* "IDI1" */
#define IMG_HDR_SIZE        4096                      /* the first flash sector holds the header, the JPEG follows */
#define IMG_MAX_BYTES       (300 * 1024)
#define TEXT_MAX            40
#define DELAY_MIN_S         2
#define DELAY_MAX_S         60
#define DELAY_DEFAULT_S     4

#define DEFAULT_ACCENT      0x4DA3FF
#define CLOCK_H             idle_font_clock.line_height
#define CLOCK_ASCENT        (idle_font_clock.line_height - idle_font_clock.base_line)
#define CLOCK_DIGIT_MID     (CLOCK_ASCENT - 46)       /* vertical middle of a digit, measured from the top of the clock label */

enum { TH_MINIMAL, TH_DARK, TH_NEON, TH_PHOTO };

typedef struct {                                      /* what is kept in NVS (and compared with the companion's answer) */
    uint32_t magic;
    uint32_t version;                                 /* the companion's settings version this was made from */
    uint32_t accent;                                  /* 0xRRGGBB */
    uint32_t img_crc, img_size;                       /* the background picture (size 0 = none) */
    uint16_t delay_s;
    uint8_t theme, bg_mode, show_clock, clock_24h;
    uint8_t show_date, date_fmt;                      /* IDLE_DATE_FMT_* */
    char text[TEXT_MAX + 1];
} idle_cfg_t;

typedef struct {                                      /* the stored layout of the first release (IDL1) */
    uint32_t magic, version, accent, img_crc, img_size;
    uint16_t delay_s;
    uint8_t theme, bg_mode, show_clock, clock_24h;
    char text[TEXT_MAX + 1];
} idle_cfg_v1_t;

typedef struct {                                      /* first sector of the idle_img partition */
    uint32_t magic, size, crc;
    uint16_t w, h;
} img_hdr_t;

static struct {
    idle_cfg_t cfg;                                   /* what is displayed */
    idle_cfg_t pending;                               /* a config waiting for its picture */
    bool pending_valid;
    uint32_t photo_failed_crc;                        /* a picture that arrived intact but could not be decoded: do not fetch it again */
    bool loaded;                                      /* stored configuration has been read */
    SemaphoreHandle_t work;                           /* serialises load / sync (never held together with the LVGL lock by a waiter) */

    idle_tap_cb_t tap;
    void *tap_ctx;

    lv_obj_t *scr, *bg, *dim, *dot, *conn, *clock, *shadow[4], *ampm, *line, *text, *tshadow, *status, *date, *dshadow[4];
    lv_image_dsc_t dsc[4];                            /* rotated so a new buffer always has a new source pointer */
    int dsc_next;
    uint16_t *bg_px;                                  /* generated theme background currently on screen (NULL when the photo is) */
    uint16_t *photo_px;                               /* the decoded picture (NULL = none / unusable) */
    lv_timer_t *tick;
    bool active;

    int64_t clock_base_ms;                            /* local time minus esp_timer time, 0 = never synced */
    portMUX_TYPE clock_mux;
    char shown_clock[8];
    char shown_date[20];
    char status_text[48];
} s = { .clock_mux = portMUX_INITIALIZER_UNLOCKED };

static const int8_t RING[4][2] = { { -3, 0 }, { 3, 0 }, { 0, -3 }, { 0, 3 } };
static const int8_t DRING[4][2] = { { -2, 0 }, { 2, 0 }, { 0, -2 }, { 0, 2 } };      /* the date's outline / glow is a little tighter than the clock's */

/* ---- small helpers ----------------------------------------------------------------------------------------- */

static inline int clampi(int v, int lo, int hi)
{
    return v < lo ? lo : (v > hi ? hi : v);
}

static int64_t now_ms(void)
{
    return esp_timer_get_time() / 1000;
}

static uint32_t crc32_of(const uint8_t *data, size_t len)
{
    return esp_rom_crc32_le(0, data, len);            /* the same value as zlib.crc32 on the PC */
}

static void cfg_defaults(idle_cfg_t *c)
{
    memset(c, 0, sizeof *c);
    c->magic = CFG_MAGIC;
    c->accent = DEFAULT_ACCENT;
    c->theme = TH_DARK;
    c->show_clock = 1;
    c->clock_24h = 1;
    c->show_date = 1;
    c->date_fmt = IDLE_DATE_FMT_MON_D_Y;
    c->delay_s = DELAY_DEFAULT_S;
}

static bool cfg_sane(const idle_cfg_t *c)
{
    return c->magic == CFG_MAGIC && c->theme <= TH_PHOTO && c->delay_s >= DELAY_MIN_S && c->delay_s <= DELAY_MAX_S &&
           c->img_size <= IMG_MAX_BYTES && c->text[TEXT_MAX] == '\0' && c->date_fmt < IDLE_DATE_FMT_COUNT && c->show_date <= 1;
}

/* ---- persistence --------------------------------------------------------------------------------------------- */

static bool nvs_load_cfg(idle_cfg_t *c)
{
    nvs_handle_t h;
    if (nvs_open(NVS_NS, NVS_READONLY, &h) != ESP_OK) {
        return false;
    }
    size_t len = 0;
    esp_err_t err = nvs_get_blob(h, NVS_KEY, NULL, &len);       /* the size says which layout was stored */
    bool ok = false;
    if (err == ESP_OK && len == sizeof *c) {
        len = sizeof *c;
        ok = nvs_get_blob(h, NVS_KEY, c, &len) == ESP_OK && len == sizeof *c && cfg_sane(c);
    } else if (err == ESP_OK && len == sizeof(idle_cfg_v1_t)) {  /* a first-release blob: keep every setting, the date gets its defaults */
        idle_cfg_v1_t old;
        len = sizeof old;
        if (nvs_get_blob(h, NVS_KEY, &old, &len) == ESP_OK && len == sizeof old && old.magic == CFG_MAGIC_V1) {
            cfg_defaults(c);
            c->version = old.version;
            c->accent = old.accent;
            c->img_crc = old.img_crc;
            c->img_size = old.img_size;
            c->delay_s = old.delay_s;
            c->theme = old.theme;
            c->bg_mode = old.bg_mode;
            c->show_clock = old.show_clock;
            c->clock_24h = old.clock_24h;
            memcpy(c->text, old.text, sizeof c->text);
            ok = cfg_sane(c);
            if (ok) {
                ESP_LOGI(TAG, "stored settings migrated from the first release layout");
            }
        }
    }
    nvs_close(h);
    return ok;
}

static void nvs_save_cfg(const idle_cfg_t *c)
{
    nvs_handle_t h;
    if (nvs_open(NVS_NS, NVS_READWRITE, &h) != ESP_OK) {
        ESP_LOGW(TAG, "cannot open NVS to store the idle settings");
        return;
    }
    if (nvs_set_blob(h, NVS_KEY, c, sizeof *c) != ESP_OK || nvs_commit(h) != ESP_OK) {
        ESP_LOGW(TAG, "storing the idle settings failed");
    }
    nvs_close(h);
}

static const esp_partition_t *img_part(void)
{
    return esp_partition_find_first(ESP_PARTITION_TYPE_DATA, (esp_partition_subtype_t)PART_SUBTYPE, PART_LABEL);
}

/* Header sector first (so an interrupted write leaves "no picture"), then the data, the header last. Sector by sector with a short
 * pause so the display refresh and Wi-Fi keep running while the flash is busy. */
static bool img_store(const uint8_t *jpeg, size_t len, uint32_t crc)
{
    const esp_partition_t *p = img_part();
    if (!p || len == 0 || len + IMG_HDR_SIZE > p->size) {
        return false;
    }
    if (esp_partition_erase_range(p, 0, IMG_HDR_SIZE) != ESP_OK) {
        return false;
    }
    const size_t data_end = (IMG_HDR_SIZE + len + 4095) & ~(size_t)4095;
    for (size_t off = IMG_HDR_SIZE; off < data_end; off += 4096) {
        size_t n = len - (off - IMG_HDR_SIZE) < 4096 ? len - (off - IMG_HDR_SIZE) : 4096;
        if (esp_partition_erase_range(p, off, 4096) != ESP_OK || esp_partition_write(p, off, jpeg + (off - IMG_HDR_SIZE), n) != ESP_OK) {
            return false;
        }
        vTaskDelay(pdMS_TO_TICKS(8));
    }
    img_hdr_t h = { .magic = IMG_MAGIC, .size = (uint32_t)len, .crc = crc, .w = SCR, .h = SCR };
    return esp_partition_write(p, 0, &h, sizeof h) == ESP_OK;
}

static void img_invalidate(void)
{
    const esp_partition_t *p = img_part();
    if (p) {
        esp_partition_erase_range(p, 0, IMG_HDR_SIZE);
    }
}

/* The stored picture into a PSRAM buffer (caller frees); NULL if there is none / it is damaged. */
static uint8_t *img_load(size_t *len_out, uint32_t expect_crc)
{
    const esp_partition_t *p = img_part();
    img_hdr_t h;
    if (!p || esp_partition_read(p, 0, &h, sizeof h) != ESP_OK || h.magic != IMG_MAGIC || h.size == 0 || h.size > IMG_MAX_BYTES ||
        h.size + IMG_HDR_SIZE > p->size || (expect_crc && h.crc != expect_crc)) {
        return NULL;
    }
    uint8_t *buf = heap_caps_malloc(h.size, MALLOC_CAP_SPIRAM | MALLOC_CAP_8BIT);
    if (!buf) {
        return NULL;
    }
    if (esp_partition_read(p, IMG_HDR_SIZE, buf, h.size) != ESP_OK || crc32_of(buf, h.size) != h.crc) {
        ESP_LOGW(TAG, "stored picture is damaged");
        heap_caps_free(buf);
        return NULL;
    }
    *len_out = h.size;
    return buf;
}

/* ---- pictures and backgrounds --------------------------------------------------------------------------------- */

static const uint8_t BAYER[4][4] = { { 0, 8, 2, 10 }, { 12, 4, 14, 6 }, { 3, 11, 1, 9 }, { 15, 7, 13, 5 } };

/* The companion's 480x480 baseline JPEG -> dithered RGB565 in PSRAM (so smooth, blurred areas do not band). NULL if unusable. */
static uint16_t *decode_photo(const uint8_t *jpeg, size_t len)
{
    uint8_t *rgb = heap_caps_aligned_alloc(64, RGB_BYTES, MALLOC_CAP_SPIRAM | MALLOC_CAP_8BIT);
    uint16_t *px = heap_caps_aligned_alloc(64, BG_BYTES, MALLOC_CAP_SPIRAM | MALLOC_CAP_8BIT);
    if (!rgb || !px) {
        ESP_LOGW(TAG, "no PSRAM to decode the picture");
        heap_caps_free(rgb);
        heap_caps_free(px);
        return NULL;
    }
    esp_jpeg_image_cfg_t cfg = {
        .indata = (uint8_t *)jpeg, .indata_size = (uint32_t)len, .outbuf = rgb, .outbuf_size = RGB_BYTES,
        .out_format = JPEG_IMAGE_FORMAT_RGB888, .out_scale = JPEG_IMAGE_SCALE_0,
    };
    esp_jpeg_image_output_t info = { 0 };
    esp_err_t err = esp_jpeg_get_image_info(&cfg, &info);
    if (err == ESP_OK && (info.width != SCR || info.height != SCR || info.output_len > RGB_BYTES)) {
        ESP_LOGW(TAG, "picture is %ux%u, expected %dx%d", (unsigned)info.width, (unsigned)info.height, SCR, SCR);
        err = ESP_ERR_INVALID_SIZE;
    }
    if (err == ESP_OK) {
        memset(&cfg.priv, 0, sizeof cfg.priv);
        err = esp_jpeg_decode(&cfg, &info);
    }
    if (err != ESP_OK) {
        ESP_LOGW(TAG, "picture decode failed: %s", esp_err_to_name(err));
        heap_caps_free(rgb);
        heap_caps_free(px);
        return NULL;
    }
    for (int y = 0; y < SCR; y++) {
        const uint8_t *p = rgb + (size_t)y * SCR * 3;
        uint16_t *out = px + (size_t)y * SCR;
        for (int x = 0; x < SCR; x++, p += 3) {
            int d = BAYER[y & 3][x & 3] * 2 - 15;
            int r = clampi(p[0] + ((d * 8) >> 5), 0, 255) >> 3;
            int g = clampi(p[1] + ((d * 4) >> 5), 0, 255) >> 2;
            int b = clampi(p[2] + ((d * 8) >> 5), 0, 255) >> 3;
            out[x] = (uint16_t)((r << 11) | (g << 5) | b);
        }
    }
    heap_caps_free(rgb);
    return px;
}

/* A dithered vertical gradient for the built-in themes (+ an accent-coloured glow along the bottom for Neon). */
static uint16_t *make_theme_bg(uint8_t theme, uint32_t accent)
{
    uint16_t *px = heap_caps_aligned_alloc(64, BG_BYTES, MALLOC_CAP_SPIRAM | MALLOC_CAP_8BIT);
    if (!px) {
        return NULL;
    }
    static const int TOP[3][3] = { { 6, 6, 9 }, { 29, 29, 54 }, { 16, 8, 42 } };
    static const int BOT[3][3] = { { 0, 0, 0 }, { 7, 7, 12 }, { 4, 3, 14 } };
    const int *top = TOP[theme > TH_NEON ? TH_DARK : theme], *bot = BOT[theme > TH_NEON ? TH_DARK : theme];
    const int ar = (accent >> 16) & 0xFF, ag = (accent >> 8) & 0xFF, ab = accent & 0xFF;
    for (int y = 0; y < SCR; y++) {
        const int t = y * 256 / (SCR - 1);
        int base[3];
        for (int c = 0; c < 3; c++) {
            base[c] = top[c] * (256 - t) + bot[c] * t;                       /* value * 256 */
        }
        const float dy = ((float)y - 520.0f) / 230.0f;
        for (int x = 0; x < SCR; x++) {
            int v[3] = { base[0], base[1], base[2] };
            if (theme == TH_NEON && y > 280) {
                const float dx = ((float)x - 240.0f) / 360.0f;
                const float d = sqrtf(dx * dx + dy * dy);
                if (d < 1.0f) {
                    const float g = (1.0f - d) * (1.0f - d) * 0.5f;
                    v[0] += (int)(ar * g * 256.0f);
                    v[1] += (int)(ag * g * 256.0f);
                    v[2] += (int)(ab * g * 256.0f);
                }
            }
            const int dth = BAYER[y & 3][x & 3] * 2 - 15;
            const int r = clampi(v[0] + dth * 64, 0, 65535) >> 11;
            const int g = clampi(v[1] + dth * 32, 0, 65535) >> 10;
            const int b = clampi(v[2] + dth * 64, 0, 65535) >> 11;
            px[y * SCR + x] = (uint16_t)((r << 11) | (g << 5) | b);
        }
    }
    return px;
}

static lv_image_dsc_t *next_dsc(const uint16_t *px)
{
    lv_image_dsc_t *d = &s.dsc[s.dsc_next];
    s.dsc_next = (s.dsc_next + 1) % 4;
    memset(d, 0, sizeof *d);
    d->header.magic = LV_IMAGE_HEADER_MAGIC;
    d->header.cf = LV_COLOR_FORMAT_RGB565;
    d->header.w = SCR;
    d->header.h = SCR;
    d->header.stride = SCR * 2;
    d->data_size = BG_BYTES;
    d->data = (const uint8_t *)px;
    return d;
}

/* ---- clock --------------------------------------------------------------------------------------------------- */

static void update_clock_text(void)
{
    int64_t base;
    portENTER_CRITICAL(&s.clock_mux);
    base = s.clock_base_ms;
    portEXIT_CRITICAL(&s.clock_mux);
    char txt[8] = "", dtxt[sizeof s.shown_date] = "";
    const char *ap = "";
    if (base != 0) {
        const int64_t local = base + now_ms();                /* the PC's local time: its own offset (time zone, daylight saving) is already in it */
        const int sec = (int)((local / 1000) % 86400);
        const int h = sec / 3600, m = (sec / 60) % 60;
        if (s.cfg.clock_24h) {
            snprintf(txt, sizeof txt, "%02d:%02d", h, m);
        } else {
            snprintf(txt, sizeof txt, "%d:%02d", h % 12 == 0 ? 12 : h % 12, m);
            ap = h < 12 ? "AM" : "PM";
        }
        if (s.cfg.show_date) {                                /* changes at local midnight with no help from the PC: the same running timer */
            idle_format_clock_date(dtxt, sizeof dtxt, local, s.cfg.date_fmt);
        }
    }
    if (strcmp(txt, s.shown_clock) != 0) {
        strlcpy(s.shown_clock, txt, sizeof s.shown_clock);
        lv_label_set_text(s.clock, txt);
        for (int i = 0; i < 4; i++) {
            lv_label_set_text(s.shadow[i], txt);
        }
        lv_label_set_text(s.ampm, ap);
        lv_obj_update_layout(s.clock);
        lv_obj_align_to(s.ampm, s.clock, LV_ALIGN_OUT_RIGHT_BOTTOM, 6, -(idle_font_clock.base_line - 8));
    }
    if (strcmp(dtxt, s.shown_date) != 0) {
        strlcpy(s.shown_date, dtxt, sizeof s.shown_date);
        lv_label_set_text(s.date, dtxt);
        for (int i = 0; i < 4; i++) {
            lv_label_set_text(s.dshadow[i], dtxt);
        }
    }
}

static void tick_cb(lv_timer_t *t)
{
    (void)t;
    update_clock_text();
}

/* ---- the screen ------------------------------------------------------------------------------------------------ */

static void inert(lv_obj_t *o)
{
    lv_obj_remove_flag(o, LV_OBJ_FLAG_CLICKABLE | LV_OBJ_FLAG_SCROLLABLE);
}

static lv_obj_t *mk_label(const lv_font_t *font, uint32_t colour)
{
    lv_obj_t *l = lv_label_create(s.scr);
    lv_obj_set_style_text_font(l, font, 0);
    lv_obj_set_style_text_color(l, lv_color_hex(colour), 0);
    inert(l);
    return l;
}

static void on_tap(lv_event_t *e)
{
    (void)e;
    if (s.tap) {
        s.tap(s.tap_ctx);
    }
}

static uint8_t effective_theme(void)
{
    if (s.cfg.theme == TH_PHOTO) {
        return s.photo_px ? TH_PHOTO : TH_DARK;           /* no usable picture: the built-in Dark theme */
    }
    return s.cfg.theme;
}

/* Colours, layout and the background for the current config. LVGL lock held. `new_bg` = a generated background for a built-in theme
 * (ownership passes here), NULL for the Photo theme. */
static void commit_theme(uint16_t *new_bg, uint8_t eff)
{
    uint16_t *old_bg = s.bg_px;
    if (eff == TH_PHOTO) {
        lv_image_set_src(s.bg, next_dsc(s.photo_px));
        lv_obj_remove_flag(s.dim, LV_OBJ_FLAG_HIDDEN);
        s.bg_px = NULL;
        heap_caps_free(new_bg);
    } else if (new_bg) {
        lv_image_set_src(s.bg, next_dsc(new_bg));
        lv_obj_add_flag(s.dim, LV_OBJ_FLAG_HIDDEN);
        s.bg_px = new_bg;
    } else {
        return;                                           /* no memory for a new background: keep what is shown */
    }
    heap_caps_free(old_bg);

    const uint32_t acc = s.cfg.accent;
    const bool clock = s.cfg.show_clock, text = s.cfg.text[0] != '\0', date = s.cfg.show_date != 0;
    const bool neon = eff == TH_NEON, photo = eff == TH_PHOTO, minimal = eff == TH_MINIMAL;

    lv_obj_set_style_bg_color(s.dot, lv_color_hex(acc), 0);
    lv_obj_set_style_bg_color(s.line, lv_color_hex(acc), 0);
    lv_obj_set_style_shadow_width(s.line, neon ? 16 : 0, 0);
    lv_obj_set_style_shadow_color(s.line, lv_color_hex(acc), 0);
    lv_obj_set_style_shadow_opa(s.line, LV_OPA_60, 0);
    if (minimal) {
        lv_obj_add_flag(s.line, LV_OBJ_FLAG_HIDDEN);
    } else {
        lv_obj_remove_flag(s.line, LV_OBJ_FLAG_HIDDEN);
    }

    /* glow (Neon) or dark outline (Photo) behind the big digits and the custom line, for legibility */
    for (int i = 0; i < 4; i++) {
        lv_obj_set_style_text_color(s.shadow[i], neon ? lv_color_hex(acc) : lv_color_black(), 0);
        lv_obj_set_style_text_opa(s.shadow[i], neon ? 46 : 110, 0);
        if (clock && (neon || photo)) {
            lv_obj_remove_flag(s.shadow[i], LV_OBJ_FLAG_HIDDEN);
        } else {
            lv_obj_add_flag(s.shadow[i], LV_OBJ_FLAG_HIDDEN);
        }
    }
    for (int i = 0; i < 4; i++) {                         /* the date gets the same treatment, a little tighter */
        lv_obj_set_style_text_color(s.dshadow[i], neon ? lv_color_hex(acc) : lv_color_black(), 0);
        lv_obj_set_style_text_opa(s.dshadow[i], neon ? 46 : 110, 0);
        if (date && (neon || photo)) {
            lv_obj_remove_flag(s.dshadow[i], LV_OBJ_FLAG_HIDDEN);
        } else {
            lv_obj_add_flag(s.dshadow[i], LV_OBJ_FLAG_HIDDEN);
        }
    }
    if (date) lv_obj_remove_flag(s.date, LV_OBJ_FLAG_HIDDEN); else lv_obj_add_flag(s.date, LV_OBJ_FLAG_HIDDEN);
    lv_obj_set_style_text_opa(s.tshadow, 130, 0);
    if (text && photo) {
        lv_obj_remove_flag(s.tshadow, LV_OBJ_FLAG_HIDDEN);
    } else {
        lv_obj_add_flag(s.tshadow, LV_OBJ_FLAG_HIDDEN);
    }

    if (clock) lv_obj_remove_flag(s.clock, LV_OBJ_FLAG_HIDDEN); else lv_obj_add_flag(s.clock, LV_OBJ_FLAG_HIDDEN);
    if (clock && !s.cfg.clock_24h) lv_obj_remove_flag(s.ampm, LV_OBJ_FLAG_HIDDEN); else lv_obj_add_flag(s.ampm, LV_OBJ_FLAG_HIDDEN);

    /* layout (480 x 480): vertical centres of the clock digits, the date and the custom line, and the top of the accent line. The same
     * numbers are in the companion's preview (idle.py), see docs/idle-screen.md. */
    int clock_cy = 0, date_cy = 0, line_y, text_cy = 0;
    const lv_font_t *text_font = (clock || date) ? &lv_font_montserrat_32 : &lv_font_montserrat_48;
    const lv_font_t *date_font = clock ? &lv_font_montserrat_26 : &lv_font_montserrat_48;
    if (date) {
        if (clock && text)      { clock_cy = 138; date_cy = 214; line_y = 252; text_cy = 300; }
        else if (clock)         { clock_cy = 172; date_cy = 252; line_y = 296; }
        else if (text)          { date_cy = 178;  line_y = 236; text_cy = 290; }
        else                    { date_cy = 215;  line_y = 262; }
    } else {
        if (clock && text)      { clock_cy = 168; line_y = 262; text_cy = 306; }
        else if (clock)         { clock_cy = 205; line_y = 300; }
        else if (text)          { text_cy = 215;  line_y = 268; }
        else                    { line_y = 240; }
    }
    lv_obj_set_style_text_font(s.text, text_font, 0);
    lv_obj_set_style_text_font(s.tshadow, text_font, 0);
    lv_label_set_text(s.text, s.cfg.text);
    lv_label_set_text(s.tshadow, s.cfg.text);
    if (text) lv_obj_remove_flag(s.text, LV_OBJ_FLAG_HIDDEN); else lv_obj_add_flag(s.text, LV_OBJ_FLAG_HIDDEN);
    const int clock_top = clock_cy - CLOCK_DIGIT_MID;
    lv_obj_align(s.clock, LV_ALIGN_TOP_MID, 0, clock_top);
    for (int i = 0; i < 4; i++) {
        lv_obj_align(s.shadow[i], LV_ALIGN_TOP_MID, RING[i][0], clock_top + RING[i][1]);
    }
    lv_obj_align(s.line, LV_ALIGN_TOP_MID, 0, line_y);
    lv_obj_set_style_text_font(s.date, date_font, 0);
    const int dh = lv_font_get_line_height(date_font);
    lv_obj_align(s.date, LV_ALIGN_TOP_MID, 0, date_cy - dh / 2);
    for (int i = 0; i < 4; i++) {
        lv_obj_set_style_text_font(s.dshadow[i], date_font, 0);
        lv_obj_align(s.dshadow[i], LV_ALIGN_TOP_MID, DRING[i][0], date_cy - dh / 2 + DRING[i][1]);
    }
    const int th = lv_font_get_line_height(text_font);
    lv_obj_align(s.text, LV_ALIGN_TOP_MID, 0, text_cy - th / 2);
    lv_obj_align(s.tshadow, LV_ALIGN_TOP_MID, 0, text_cy - th / 2 + 2);

    s.shown_clock[0] = '\0';                              /* force the clock label to be rewritten in the (possibly new) format */
    s.shown_date[0] = '\0';
    update_clock_text();
}

/* Generate the background outside the LVGL lock, then swap it in. work lock held by the caller. */
static void rebuild_theme(void)
{
    const uint8_t eff = effective_theme();
    uint16_t *bg = eff == TH_PHOTO ? NULL : make_theme_bg(eff, s.cfg.accent);
    if (eff != TH_PHOTO && !bg) {
        ESP_LOGW(TAG, "no PSRAM for the idle background");
    }
    if (!bsp_display_lock(2000)) {
        heap_caps_free(bg);
        return;
    }
    commit_theme(bg, eff);
    bsp_display_unlock();
}

/* ---- public: screen ------------------------------------------------------------------------------------------- */

static void load_task(void *arg)
{
    (void)arg;
    xSemaphoreTake(s.work, portMAX_DELAY);
    idle_cfg_t c;
    if (nvs_load_cfg(&c)) {
        s.cfg = c;
        if (c.img_size) {
            size_t len = 0;
            uint8_t *jpeg = img_load(&len, c.img_crc);
            if (jpeg) {
                s.photo_px = decode_photo(jpeg, len);
                heap_caps_free(jpeg);
            }
            if (!s.photo_px) {
                ESP_LOGW(TAG, "the stored picture cannot be shown: using the built-in theme until the companion resends it");
                s.cfg.img_crc = 0;                         /* so the next sync downloads it again ... */
                s.cfg.version = 0;                         /* ... which it only does when the version looks out of date */
            }
        }
        ESP_LOGI(TAG, "stored settings loaded: version %u, theme %u%s", (unsigned)s.cfg.version, (unsigned)s.cfg.theme, s.photo_px ? ", picture" : "");
    }
    rebuild_theme();
    s.loaded = true;
    xSemaphoreGive(s.work);
    vTaskDelete(NULL);
}

void idle_screen_init(idle_tap_cb_t on_tap_cb, void *ctx)
{
    cfg_defaults(&s.cfg);
    s.tap = on_tap_cb;
    s.tap_ctx = ctx;
    s.work = xSemaphoreCreateMutex();
    if (!s.work || !bsp_display_lock(0)) {
        return;
    }
    s.scr = lv_obj_create(NULL);
    lv_obj_set_style_bg_color(s.scr, lv_color_black(), 0);
    lv_obj_set_style_bg_opa(s.scr, LV_OPA_COVER, 0);
    lv_obj_remove_flag(s.scr, LV_OBJ_FLAG_SCROLLABLE);
    lv_obj_add_flag(s.scr, LV_OBJ_FLAG_CLICKABLE);
    lv_obj_add_event_cb(s.scr, on_tap, LV_EVENT_CLICKED, NULL);

    s.bg = lv_image_create(s.scr);
    lv_obj_set_size(s.bg, SCR, SCR);
    lv_obj_set_pos(s.bg, 0, 0);
    inert(s.bg);

    s.dim = lv_obj_create(s.scr);                         /* a photo is dimmed a little so the white clock stays readable */
    lv_obj_remove_style_all(s.dim);
    lv_obj_set_size(s.dim, SCR, SCR);
    lv_obj_set_style_bg_color(s.dim, lv_color_black(), 0);
    lv_obj_set_style_bg_opa(s.dim, LV_OPA_30, 0);
    inert(s.dim);
    lv_obj_add_flag(s.dim, LV_OBJ_FLAG_HIDDEN);

    for (int i = 0; i < 4; i++) {
        s.shadow[i] = mk_label(&idle_font_clock, 0x000000);
    }
    s.clock = mk_label(&idle_font_clock, 0xFFFFFF);
    s.ampm = mk_label(&lv_font_montserrat_26, 0xDADAE4);
    for (int i = 0; i < 4; i++) {                          /* the date: an outline / glow (Photo, Neon) behind a light label */
        s.dshadow[i] = mk_label(&lv_font_montserrat_26, 0x000000);
    }
    s.date = mk_label(&lv_font_montserrat_26, 0xE6E6EE);
    for (int i = 0; i < 5; i++) {
        lv_obj_t *l = i < 4 ? s.dshadow[i] : s.date;
        lv_obj_set_width(l, 440);
        lv_obj_set_style_text_align(l, LV_TEXT_ALIGN_CENTER, 0);
        lv_label_set_long_mode(l, LV_LABEL_LONG_MODE_CLIP);   /* never wraps: even the widest format fits 440 px at 48 px */
    }
    s.line = lv_obj_create(s.scr);
    lv_obj_remove_style_all(s.line);
    lv_obj_set_size(s.line, 64, 3);
    lv_obj_set_style_radius(s.line, LV_RADIUS_CIRCLE, 0);
    lv_obj_set_style_bg_opa(s.line, LV_OPA_COVER, 0);
    inert(s.line);
    s.tshadow = mk_label(&lv_font_montserrat_32, 0x000000);
    s.text = mk_label(&lv_font_montserrat_32, 0xF2F2F7);
    for (lv_obj_t *l = s.text; l; l = (l == s.text ? s.tshadow : NULL)) {
        lv_obj_set_width(l, 440);
        lv_obj_set_style_text_align(l, LV_TEXT_ALIGN_CENTER, 0);
        lv_label_set_long_mode(l, LV_LABEL_LONG_MODE_DOTS);
    }

    s.dot = lv_obj_create(s.scr);                         /* subtle connection state at the top: a dot + "Connected" */
    lv_obj_remove_style_all(s.dot);
    lv_obj_set_size(s.dot, 6, 6);
    lv_obj_set_style_radius(s.dot, LV_RADIUS_CIRCLE, 0);
    lv_obj_set_style_bg_opa(s.dot, LV_OPA_COVER, 0);
    lv_obj_set_pos(s.dot, 188, 20);
    inert(s.dot);
    s.conn = mk_label(&lv_font_montserrat_12, 0x8C90AA);
    lv_label_set_text(s.conn, "Connected");
    lv_obj_set_pos(s.conn, 200, 16);

    s.status = mk_label(&lv_font_montserrat_14, 0x8C90AA);
    lv_obj_set_width(s.status, 440);
    lv_obj_set_style_text_align(s.status, LV_TEXT_ALIGN_CENTER, 0);
    lv_label_set_long_mode(s.status, LV_LABEL_LONG_MODE_DOTS);
    lv_obj_align(s.status, LV_ALIGN_TOP_MID, 0, 436);
    lv_label_set_text(s.status, "Nothing playing");
    strlcpy(s.status_text, "Nothing playing", sizeof s.status_text);

    s.tick = lv_timer_create(tick_cb, 1000, NULL);
    lv_timer_pause(s.tick);
    bsp_display_unlock();

#ifdef APP_DEV_TOOLS
    {
        const char *bad = idle_date_selftest();
        if (bad) {
            ESP_LOGE(TAG, "idle date selftest FAILED: %s", bad);
        } else {
            ESP_LOGI(TAG, "idle date selftest ok");
        }
    }
#endif
    xTaskCreatePinnedToCore(load_task, "idle_load", 8192, NULL, 3, NULL, 0);
}

lv_obj_t *idle_screen_obj(void)
{
    return s.scr;
}

void idle_screen_activate(bool visible)
{
    if (!s.scr || !bsp_display_lock(1000)) {
        return;
    }
    s.active = visible;
    if (visible) {
        update_clock_text();
        lv_timer_resume(s.tick);
    } else {
        lv_timer_pause(s.tick);
    }
    bsp_display_unlock();
}

void idle_screen_set_clock(int64_t local_ms)
{
    if (local_ms <= 0) {
        return;
    }
    portENTER_CRITICAL(&s.clock_mux);
    s.clock_base_ms = local_ms - now_ms();
    if (s.clock_base_ms == 0) {
        s.clock_base_ms = 1;                              /* 0 means "never synced" */
    }
    portEXIT_CRITICAL(&s.clock_mux);
}

void idle_screen_set_status(const char *text)
{
    text = text ? text : "";
    if (!s.scr || strcmp(text, s.status_text) == 0 || !bsp_display_lock(1000)) {
        return;
    }
    strlcpy(s.status_text, text, sizeof s.status_text);
    lv_label_set_text(s.status, s.status_text);
    bsp_display_unlock();
}

uint32_t idle_screen_delay_ms(void)
{
    return (uint32_t)s.cfg.delay_s * 1000U;
}

/* ---- public: sync ----------------------------------------------------------------------------------------------- */

bool idle_screen_have_version(uint32_t version)
{
    if (!s.work || xSemaphoreTake(s.work, pdMS_TO_TICKS(4000)) != pdTRUE) {
        return true;                                      /* still loading: do not start a sync now */
    }
    const bool have = s.loaded && s.cfg.version == version;
    xSemaphoreGive(s.work);
    return have;
}

static bool parse_config(const char *json, size_t len, idle_cfg_t *n)
{
    cJSON *j = cJSON_ParseWithLength(json, len);
    if (!j) {
        return false;
    }
    bool ok = false;
    const cJSON *ver = cJSON_GetObjectItemCaseSensitive(j, "version");
    if (cJSON_IsTrue(cJSON_GetObjectItemCaseSensitive(j, "ok")) && cJSON_IsNumber(ver) && ver->valuedouble >= 1) {
        cfg_defaults(n);
        n->version = (uint32_t)ver->valuedouble;
        const cJSON *v = cJSON_GetObjectItemCaseSensitive(j, "theme");
        if (cJSON_IsString(v)) {
            n->theme = !strcmp(v->valuestring, "minimal") ? TH_MINIMAL : !strcmp(v->valuestring, "neon") ? TH_NEON :
                       !strcmp(v->valuestring, "photo") ? TH_PHOTO : TH_DARK;
        }
        v = cJSON_GetObjectItemCaseSensitive(j, "accent");
        if (cJSON_IsString(v) && strlen(v->valuestring) == 7 && v->valuestring[0] == '#') {
            char *end = NULL;
            unsigned long rgb = strtoul(v->valuestring + 1, &end, 16);
            if (end && *end == '\0') {
                n->accent = (uint32_t)rgb & 0xFFFFFF;
            }
        }
        v = cJSON_GetObjectItemCaseSensitive(j, "clock");
        n->show_clock = cJSON_IsFalse(v) ? 0 : 1;
        v = cJSON_GetObjectItemCaseSensitive(j, "clock_24h");
        n->clock_24h = cJSON_IsFalse(v) ? 0 : 1;
        v = cJSON_GetObjectItemCaseSensitive(j, "date");                    /* an older companion sends none: the date defaults to shown */
        n->show_date = cJSON_IsFalse(v) ? 0 : 1;
        v = cJSON_GetObjectItemCaseSensitive(j, "date_fmt");
        n->date_fmt = (cJSON_IsNumber(v) && v->valuedouble >= 0 && v->valuedouble < IDLE_DATE_FMT_COUNT) ? (uint8_t)v->valuedouble : IDLE_DATE_FMT_MON_D_Y;
        v = cJSON_GetObjectItemCaseSensitive(j, "delay_s");
        if (cJSON_IsNumber(v)) {
            n->delay_s = (uint16_t)clampi((int)v->valuedouble, DELAY_MIN_S, DELAY_MAX_S);
        }
        v = cJSON_GetObjectItemCaseSensitive(j, "bg_mode");
        n->bg_mode = cJSON_IsString(v) ? (!strcmp(v->valuestring, "fit") ? 1 : !strcmp(v->valuestring, "blur") ? 2 : 0) : 0;
        v = cJSON_GetObjectItemCaseSensitive(j, "text");
        if (cJSON_IsString(v)) {                          /* printable ASCII only: the display fonts have nothing else */
            size_t o = 0;
            for (const unsigned char *p = (const unsigned char *)v->valuestring; *p && o < TEXT_MAX; p++) {
                if (*p >= 0x20 && *p < 0x7F) {
                    n->text[o++] = (char)*p;
                }
            }
            n->text[o] = '\0';
        }
        const cJSON *img = cJSON_GetObjectItemCaseSensitive(j, "image");
        if (cJSON_IsObject(img)) {
            const cJSON *sz = cJSON_GetObjectItemCaseSensitive(img, "size"), *crc = cJSON_GetObjectItemCaseSensitive(img, "crc");
            if (cJSON_IsNumber(sz) && cJSON_IsNumber(crc) && sz->valuedouble > 100 && sz->valuedouble <= IMG_MAX_BYTES) {
                n->img_size = (uint32_t)sz->valuedouble;
                n->img_crc = (uint32_t)crc->valuedouble;
            }
        }
        ok = true;
    }
    cJSON_Delete(j);
    return ok;
}

/* The new config is final (picture, if any, is in place): remember it and redraw. work lock held. */
static void finish_apply(const idle_cfg_t *n)
{
    s.cfg = *n;
    nvs_save_cfg(&s.cfg);
    rebuild_theme();
    ESP_LOGI(TAG, "idle settings version %u applied (theme %u, %s clock, date %s/%u, %s)", (unsigned)n->version, (unsigned)n->theme,
             n->show_clock ? (n->clock_24h ? "24h" : "12h") : "no", n->show_date ? "on" : "off", (unsigned)n->date_fmt, n->img_size ? "picture" : "no picture");
}

int idle_screen_apply_config(const char *json, size_t len)
{
    if (!s.work || xSemaphoreTake(s.work, pdMS_TO_TICKS(5000)) != pdTRUE) {
        return -1;
    }
    idle_cfg_t n;
    int rc = -1;
    if (!parse_config(json, len, &n)) {
        ESP_LOGW(TAG, "unusable idle settings from the companion");
    } else {
        const bool same_pic = n.img_size && n.img_size == s.cfg.img_size && n.img_crc == s.cfg.img_crc && s.photo_px;
        const bool known_bad = n.img_size && n.img_crc == s.photo_failed_crc;
        if (n.img_size && !same_pic && !known_bad) {
            s.pending = n;
            s.pending_valid = true;
            rc = 1;                                       /* the picture comes next */
        } else {
            uint16_t *old = NULL;
            if (!n.img_size) {                            /* no picture any more */
                if (s.cfg.img_size) {
                    img_invalidate();
                }
                old = s.photo_px;
                s.photo_px = NULL;
            }
            finish_apply(&n);                             /* (a known-undecodable picture is not downloaded again: Dark theme) */
            heap_caps_free(old);
            rc = 0;
        }
    }
    xSemaphoreGive(s.work);
    return rc;
}

bool idle_screen_apply_picture(const uint8_t *jpeg, size_t len)
{
    if (!s.work || xSemaphoreTake(s.work, pdMS_TO_TICKS(5000)) != pdTRUE) {
        return false;
    }
    bool ok = false;
    if (s.pending_valid) {
        idle_cfg_t n = s.pending;
        s.pending_valid = false;
        if (len != n.img_size || crc32_of(jpeg, len) != n.img_crc) {
            ESP_LOGW(TAG, "picture does not match its description (%u bytes, expected %u): will retry", (unsigned)len, (unsigned)n.img_size);
        } else {
            uint16_t *photo = decode_photo(jpeg, len);
            uint16_t *old = s.photo_px;
            if (photo) {
                if (!img_store(jpeg, len, n.img_crc)) {
                    ESP_LOGW(TAG, "could not store the picture in flash: it is shown now but will be fetched again after a reboot");
                    img_invalidate();
                }
                s.photo_px = photo;
                s.photo_failed_crc = 0;
            } else {
                ESP_LOGW(TAG, "the picture cannot be decoded: falling back to the built-in theme");
                img_invalidate();
                s.photo_px = NULL;
                s.photo_failed_crc = n.img_crc;
            }
            finish_apply(&n);
            heap_caps_free(old);
            ok = true;
        }
    }
    xSemaphoreGive(s.work);
    return ok;
}
